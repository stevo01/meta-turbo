## conf/machine/turbo-arm64-k3r5.conf
```bitbake
require conf/machine/include/k3r5.inc

SYSFW_SOC = "am64x_sr2"
SYSFW_CONFIG = "evm"
SYSFW_SUFFIX = "hs-fs"

UBOOT_MACHINE = "am64x_evm_r5_defconfig"
```

## conf/machine/turbo-arm64.conf
```bitbake
#@TYPE: Machine
#@NAME: generic armv8 machine
#@DESCRIPTION: Machine configuration for running a generic armv8 (update for tests of multiconfig)

require conf/machine/include/arm/arch-armv8.inc
require conf/machine/include/qemu.inc

BBMULTICONFIG += "k3r5"

do_image_complete[mcdepends] += "multiconfig::k3r5:ti-sci-fw:do_deploy"

MACHINEOVERRIDES = "qemuarm64:${MACHINE}"

KMACHINE_turbo-arm64 ="qemuarm64"

KERNEL_IMAGETYPE = "Image"

SERIAL_CONSOLES ?= "38400;ttyAMA0 38400;hvc0"

# For runqemu
QB_SYSTEM_NAME = "qemu-system-aarch64"
QB_MEM = "-m 512"
QB_MACHINE = "-machine virt"
QB_CPU = "-cpu cortex-a57"
QB_KERNEL_CMDLINE_APPEND = "console=ttyAMA0,38400"
# Add the 'virtio-rng-pci' device otherwise the guest may run out of entropy
QB_OPT_APPEND = "-show-cursor -device virtio-rng-pci -monitor null"
QB_TAP_OPT = "-netdev tap,id=net0,ifname=@TAP@,script=no,downscript=no"
QB_NETWORK_DEVICE = "-device virtio-net-device,netdev=net0,mac=@MAC@"
QB_ROOTFS_OPT = "-drive id=disk0,file=@ROOTFS@,if=none,format=raw -device virtio-blk-device,drive=disk0"
QB_SERIAL_OPT = "-device virtio-serial-device -chardev null,id=virtcon -device virtconsole,chardev=virtcon"
QB_TCPSERIAL_OPT = " -device virtio-serial-device -chardev socket,id=virtcon,port=@PORT@,host=127.0.0.1 -device virtconsole,chardev=virtcon"
```
