## conf/distro/turbo.conf
```bitbake
DISTRO = "turbo"
DISTRO_NAME = "Turbo (with real time kernel)"

DISTRO_VERSION = "0.1"
DISTRO_CODENAME = "kirkstone"

MAINTAINER = "Steffen Volkmann <volkmann@devpool.net>"

TURBO_DEFAULT_DISTRO_FEATURES = "largefile opengl ptest multiarch wayland vulkan"

DISTRO_FEATURES ?= "${DISTRO_FEATURES_DEFAULT} ${TURBO_DEFAULT_DISTRO_FEATURES}"

PREFERRED_VERSION_linux-yocto ?= "5.15%"
PREFERRED_VERSION_linux-yocto-rt ?= "5.15%"
```

## conf/layer.conf
```bitbake
# We have a conf and classes directory, add to BBPATH
BBPATH =. "${LAYERDIR}:"

# We have recipes-* directories, add to BBFILES
BBFILES += "${LAYERDIR}/recipes-*/*/*.bb \
            ${LAYERDIR}/recipes-*/*/*.bbappend"

BBFILE_COLLECTIONS += "turbo"
BBFILE_PATTERN_turbo = "^${LAYERDIR}/"
BBFILE_PRIORITY_turbo = "6"

LAYERDEPENDS_turbo = "core"
LAYERSERIES_COMPAT_turbo = "kirkstone"

# This should only be incremented on significant changes that will
# cause compatibility issues with other layers
LAYERVERSION_turbo = "3"

REQUIRED_POKY_BBLAYERS_CONF_VERSION = "2"
```
